## CMakeLists.txt
```
cmake_minimum_required(VERSION 3.20.0)

set(KCONFIG_ROOT ${CMAKE_CURRENT_SOURCE_DIR}/Kconfig)
find_package(Zephyr REQUIRED HINTS $ENV{ZEPHYR_BASE})
project(seeed_nrf54l15_bridge)

target_sources(app PRIVATE
  src/main.cpp
  src/bridge_core.cpp
  ${CMAKE_CURRENT_SOURCE_DIR}/../rp2040-bridge/src/bridge_protocol.h
)
target_include_directories(app PRIVATE
  ${CMAKE_CURRENT_SOURCE_DIR}/src
  ${CMAKE_CURRENT_SOURCE_DIR}/../rp2040-bridge/src
)
```

## Kconfig
```
mainmenu "Seeed nRF54L15 bridge"

config SEEED_BRIDGE_UART_BAUD
    int "Host UART baud rate"
    default 115200
    range 9600 4000000
    help
      Baud rate used for the framed host protocol on UART20. This is not a
      claim that every configured rate is supported by the UART path or by a
      connected host.

source "Kconfig.zephyr"
```

## prj.conf
```kconfig
# Offline loopback bridge: no logging or console on the framed-data UART.
CONFIG_CPP=y
CONFIG_SERIAL=y
CONFIG_UART_INTERRUPT_DRIVEN=y
CONFIG_LOG=n
CONFIG_CONSOLE=n
CONFIG_UART_CONSOLE=n
CONFIG_MAIN_STACK_SIZE=4096
```

## src/main.cpp
```c
#include <zephyr/device.h>
#include <zephyr/drivers/uart.h>
#include <zephyr/kernel.h>

#include "bridge_core.h"

namespace {

const struct device* const kHostUart = DEVICE_DT_GET(DT_NODELABEL(uart20));
constexpr size_t kReadChunk = 512;
constexpr size_t kWriteCap = 4096;
constexpr int kTxTimeoutMs = 100;
constexpr int kStatPeriodMs = 5000;

[[noreturn]] void fatal() {
    k_panic();
    for (;;) {
        k_sleep(K_FOREVER);
    }
}

}  // namespace

int main() {
    if (!device_is_ready(kHostUart)) {
        fatal();
    }

    struct uart_config config = {};
    config.baudrate = CONFIG_SEEED_BRIDGE_UART_BAUD;
    config.parity = UART_CFG_PARITY_NONE;
    config.stop_bits = UART_CFG_STOP_BITS_1;
    config.data_bits = UART_CFG_DATA_BITS_8;
    config.flow_ctrl = UART_CFG_FLOW_CTRL_NONE;
    if (uart_configure(kHostUart, &config) != 0) {
        fatal();
    }

    static seeed_bridge::LoopbackCore core;
    static uint8_t read_buf[kReadChunk];
    static uint8_t write_buf[kWriteCap];
    int64_t last_stat_ms = k_uptime_get();

    for (;;) {
        size_t read_len = 0;
        while (read_len < sizeof(read_buf)) {
            unsigned char byte = 0;
            if (uart_poll_in(kHostUart, &byte) != 0) {
                break;
            }
            read_buf[read_len++] = byte;
        }

        if (read_len > 0) {
            size_t out_len =
                core.process(read_buf, read_len, write_buf, sizeof(write_buf));
            if (out_len > 0) {
                (void)uart_tx(kHostUart, write_buf, out_len, kTxTimeoutMs);
            }
        }

        if (k_uptime_get() - last_stat_ms >= kStatPeriodMs) {
            size_t out_len = core.encodeStat(write_buf, sizeof(write_buf));
            if (out_len > 0) {
                (void)uart_tx(kHostUart, write_buf, out_len, kTxTimeoutMs);
            }
            last_stat_ms = k_uptime_get();
        }

        if (read_len == 0) {
            k_sleep(K_MSEC(1));
        }
    }
}
```

## src/bridge_core.cpp
```c
#include "bridge_core.h"

#include <string.h>

namespace seeed_bridge {

LoopbackCore::LoopbackCore() : decoder_(), counters_{0} {}

bool LoopbackCore::append(uint8_t kind, const uint8_t* payload, uint16_t len,
                          uint8_t* out, size_t cap, size_t* used) {
    if (*used > cap) {
        return false;
    }
    size_t written = bridgeEncode(kind, payload, len, out + *used, cap - *used);
    if (written == 0) {
        counters_[Drops]++;
        return false;
    }
    *used += written;
    return true;
}

size_t LoopbackCore::encodeStat(uint8_t* out, size_t cap) {
    uint8_t payload[24];
    for (size_t i = 0; i < kCounterCount; i++) {
        payload[i * 4 + 0] = static_cast<uint8_t>(counters_[i] & 0xFF);
        payload[i * 4 + 1] = static_cast<uint8_t>((counters_[i] >> 8) & 0xFF);
        payload[i * 4 + 2] = static_cast<uint8_t>((counters_[i] >> 16) & 0xFF);
        payload[i * 4 + 3] = static_cast<uint8_t>((counters_[i] >> 24) & 0xFF);
    }
    size_t written = bridgeEncode(BR_STAT, payload, sizeof(payload), out, cap);
    if (written == 0) {
        counters_[Drops]++;
    }
    return written;
}

void LoopbackCore::handle(const BridgeFrame& frame, uint8_t* out, size_t cap,
                          size_t* used) {
    switch (frame.kind) {
    case BR_HELLO: {
        const uint8_t ack[8] = {
            1,
            kFirmwareMajor,
            kFirmwareMinor,
            kFirmwarePatch,
            0,
            0,
            static_cast<uint8_t>(kCapabilities & 0xFF),
            static_cast<uint8_t>(kCapabilities >> 8),
        };
        (void)append(BR_HELLO_ACK, ack, sizeof(ack), out, cap, used);
        break;
    }
    case BR_CFG: {
        CfgPayload cfg;
        uint8_t status = cfgDecode(frame.payload, frame.len, cfg) ? 1 : 3;
        uint8_t ack[10];
        cfgAckEncode(status, cfg, ack);
        counters_[Drops]++;
        (void)append(BR_CFG_ACK, ack, sizeof(ack), out, cap, used);
        break;
    }
    case BR_TX: {
        if (frame.len == 0 || frame.len > kMaxLoopbackPayload) {
            counters_[Drops]++;
            break;
        }
        uint8_t rx[6 + kMaxLoopbackPayload];
        rx[0] = 0;  // RSSI dBm, int16 LE: loopback has no RF measurement.
        rx[1] = 0;
        rx[2] = 0;  // SNR dB.
        rx[3] = 1;  // CRC OK for an in-process loopback.
        rx[4] = static_cast<uint8_t>(frame.len & 0xFF);
        rx[5] = static_cast<uint8_t>(frame.len >> 8);
        memcpy(rx + 6, frame.payload, frame.len);
        if (append(BR_RX, rx, static_cast<uint16_t>(6 + frame.len), out, cap, used)) {
            counters_[TxPackets]++;
            counters_[RxPackets]++;
        }
        break;
    }
    case BR_PING: {
        const size_t before = *used;
        if (!append(BR_PONG, NULL, 0, out, cap, used)) {
            break;
        }
        uint8_t stat[64];
        size_t n = encodeStat(stat, sizeof(stat));
        if (n == 0 || *used + n > cap) {
            *used = before;
            counters_[Drops]++;
        } else {
            memcpy(out + *used, stat, n);
            *used += n;
        }
        break;
    }
    default:
        counters_[Drops]++;
        break;
    }
}

size_t LoopbackCore::process(const uint8_t* data, size_t len, uint8_t* out, size_t cap) {
    size_t used = 0;
    if (len == 0) {
        return 0;
    }
    if (data == NULL || out == NULL || cap == 0) {
        counters_[Drops]++;
        return 0;
    }
    if (!decoder_.push(data, len)) {
        counters_[Drops]++;
        return 0;
    }

    BridgeFrame frame;
    while (decoder_.next(frame)) {
        handle(frame, out, cap, &used);
    }
    return used;
}

}  // namespace seeed_bridge
```

## src/bridge_core.h
```c
#pragma once

#include <stddef.h>
#include <stdint.h>

#include "bridge_protocol.h"

namespace seeed_bridge {

// Only variable packet length is implemented. There is no radio path yet.
static const uint16_t kCapabilities = 0x0008;
static const uint16_t kMaxLoopbackPayload = 255;
static const uint8_t kFirmwareMajor = 0;
static const uint8_t kFirmwareMinor = 1;
static const uint8_t kFirmwarePatch = 0;

// Pure host-testable bridge protocol loopback. It deliberately rejects radio
// configuration: this increment must never look like a working LR2021 bridge.
class LoopbackCore {
public:
    static const size_t kCounterCount = 6;

    LoopbackCore();

    // Consume arbitrary host bytes and append complete response frames.
    // Returns the number of appended bytes, or zero when no response is ready
    // or the output buffer is too small.
    size_t process(const uint8_t* data, size_t len, uint8_t* out, size_t cap);

    // Encode the current counters as a STAT frame.
    size_t encodeStat(uint8_t* out, size_t cap);

    const uint32_t* counters() const { return counters_; }

private:
    enum Counter {
        TxPackets = 0,
        RxPackets = 1,
        CrcErrors = 2,
        Drops = 3,
        TxTimeouts = 4,
        Resets = 5,
    };

    bool append(uint8_t kind, const uint8_t* payload, uint16_t len,
                uint8_t* out, size_t cap, size_t* used);
    void handle(const BridgeFrame& frame, uint8_t* out, size_t cap, size_t* used);

    BridgeDecoder decoder_;
    uint32_t counters_[kCounterCount];
};

}  // namespace seeed_bridge
```
