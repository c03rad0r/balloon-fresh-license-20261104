## CMakeLists.txt
```
cmake_minimum_required(VERSION 3.20.0)

set(KCONFIG_ROOT ${CMAKE_CURRENT_SOURCE_DIR}/Kconfig)
find_package(Zephyr REQUIRED HINTS $ENV{ZEPHYR_BASE})
project(seeed_nrf54l15_bridge)

target_sources(app PRIVATE
  src/main.cpp
  src/bridge_core.cpp
  src/reset_diag.cpp
  src/fatal_hook.cpp
  ${CMAKE_CURRENT_SOURCE_DIR}/../rp2040-bridge/src/bridge_protocol.h
)

if(CONFIG_SEEED_BRIDGE_FLRC)
  target_sources(app PRIVATE src/flrc_radio.cpp)
endif()
target_include_directories(app PRIVATE
  ${CMAKE_CURRENT_SOURCE_DIR}/src
  ${CMAKE_CURRENT_SOURCE_DIR}/../rp2040-bridge/src
)
```

## Kconfig
```
mainmenu "Seeed nRF54L15 bridge"

config SEEED_BRIDGE_UART_BAUD
    int "Host UART baud rate"
    default 115200
    range 9600 4000000
    help
      Baud rate used for the framed host protocol on UART20. This is not a
      claim that every configured rate is supported by the UART path or by a
      connected host.

config SEEED_BRIDGE_FLRC
    bool "Enable the LR2021 FLRC radio backend"
    default n
    help
      Build the bridge with the raw LR20xx FLRC packet path instead of the
      offline loopback. The host protocol and counters are unchanged. This
      option requires the USP/LoRa Basics Modem radio driver and the Wio-LR2021
      shield.

source "Kconfig.zephyr"
```

## prj.conf
```kconfig
# Offline loopback bridge: no logging or console on the framed-data UART.
CONFIG_CPP=y
CONFIG_SERIAL=y
CONFIG_UART_INTERRUPT_DRIVEN=y
CONFIG_UART_USE_RUNTIME_CONFIGURE=y
CONFIG_LOG=n
CONFIG_CONSOLE=n
CONFIG_UART_CONSOLE=n
CONFIG_MAIN_STACK_SIZE=4096
CONFIG_RING_BUFFER=y
```

## prj-flrc.conf
```kconfig
# FLRC radio bridge: adds the USP/RAC LR2021 packet path on top of prj.conf.
# The host framing UART remains UART20 at CONFIG_SEEED_BRIDGE_UART_BAUD.

CONFIG_SEEED_BRIDGE_FLRC=y

# Semtech USP modules and the LR20xx driver through the Wio-LR2021 shield.
CONFIG_LORA_BASICS_MODEM_DRIVERS=y
CONFIG_LORA_BASICS_MODEM_DRIVERS_EVENT_TRIGGER_GLOBAL_THREAD=y
CONFIG_USP=y

# The UART main loop runs the RAC engine directly, matching the stock FLRC
# PER sample. A separate USP thread is deliberately not used: both threads
# would be cooperative and the framed UART loop can starve radio service.
CONFIG_MAIN_STACK_SIZE=16384
CONFIG_SYSTEM_WORKQUEUE_STACK_SIZE=4096
CONFIG_MAIN_THREAD_PRIORITY=-2

# Reset/crash diagnosis: names for the fatal record, and a canary that turns a
# stack overflow into a fatal error instead of silent corruption.
CONFIG_THREAD_NAME=y
CONFIG_STACK_SENTINEL=y
CONFIG_HW_STACK_PROTECTION=y

CONFIG_HEAP_MEM_POOL_SIZE=8192
CONFIG_PM_DEVICE=y
CONFIG_TEST_RANDOM_GENERATOR=y
CONFIG_DCACHE=n
CONFIG_FLASH=y
```

## boards/xiao_nrf54l15_nrf54l15_cpuapp.overlay
```dts
/*
 * Default host transport: the XIAO's UART20, wired to the SAMD11 USB-UART.
 * The high-speed build overrides this alias with UARTE00 on D6/D7.
 */
/ {
	aliases {
		seeed-bridge-uart = &uart20;
	};
};
```

## src/main.cpp
```c
#include <zephyr/device.h>
#include <zephyr/drivers/uart.h>
#include <zephyr/kernel.h>
#include <zephyr/sys/ring_buffer.h>

#include "bridge_core.h"
#include "reset_diag.h"

#if defined(CONFIG_SEEED_BRIDGE_FLRC)
#include "flrc_radio.h"
#endif

namespace {

const struct device* const kHostUart = DEVICE_DT_GET(DT_ALIAS(seeed_bridge_uart));
constexpr size_t kReadChunk = 512;
constexpr size_t kWriteCap = 4096;
constexpr int kStatPeriodMs = 5000;

RING_BUF_DECLARE(host_rx_ring, 4096);
RING_BUF_DECLARE(host_tx_ring, 8192);
seeed_bridge::BridgeCore core;

#if defined(CONFIG_SEEED_BRIDGE_FLRC)
void onRadioTxDone(void*) { core.noteTxDone(); }
void onRadioCrcError(void*) { core.noteCrcError(); }
void onRadioTxTimeout(void*) { core.noteTxTimeout(); }
void onRadioDrop(void*) { core.noteDrop(); }
#endif


void queue_host_bytes(const uint8_t* data, size_t len) {
    size_t sent = 0;
    while (sent < len) {
        uint32_t written =
            ring_buf_put(&host_tx_ring, data + sent, static_cast<uint32_t>(len - sent));
        sent += written;
        uart_irq_tx_enable(kHostUart);
        if (sent < len) {
            k_sleep(K_MSEC(1));
        }
    }
}

void host_uart_isr(const struct device* dev, void* user_data) {
    (void)user_data;
    if (!uart_irq_update(dev)) {
        return;
    }

    if (uart_irq_rx_ready(dev)) {
        while (uart_irq_rx_ready(dev)) {
            uint8_t chunk[64];
            int received = uart_fifo_read(dev, chunk, sizeof(chunk));
            if (received <= 0) {
                break;
            }
            (void)ring_buf_put(&host_rx_ring, chunk,
                               static_cast<uint32_t>(received));
        }
    }

    if (uart_irq_tx_ready(dev)) {
        static uint8_t pending = 0;
        static bool has_pending = false;

        if (has_pending) {
            if (uart_fifo_fill(dev, &pending, 1) != 1) {
                return;
            }
            has_pending = false;
        }

        while (uart_irq_tx_ready(dev)) {
            uint8_t byte = 0;
            if (ring_buf_get(&host_tx_ring, &byte, 1) != 1) {
                uart_irq_tx_disable(dev);
                break;
            }
            if (uart_fifo_fill(dev, &byte, 1) != 1) {
                pending = byte;
                has_pending = true;
                break;
            }
        }
    }
}

[[noreturn]] void fatal() {
    k_panic();
    for (;;) {
        k_sleep(K_FOREVER);
    }
}

}  // namespace

int main() {
    if (!device_is_ready(kHostUart)) {
        fatal();
    }

    struct uart_config config = {};
    config.baudrate = CONFIG_SEEED_BRIDGE_UART_BAUD;
    config.parity = UART_CFG_PARITY_NONE;
    config.stop_bits = UART_CFG_STOP_BITS_1;
    config.data_bits = UART_CFG_DATA_BITS_8;
    config.flow_ctrl = UART_CFG_FLOW_CTRL_NONE;
    if (uart_configure(kHostUart, &config) != 0) {
        fatal();
    }
    if (uart_irq_callback_user_data_set(kHostUart, host_uart_isr, NULL) != 0) {
        fatal();
    }
    uart_irq_rx_enable(kHostUart);

#if defined(CONFIG_SEEED_BRIDGE_FLRC)
    static seeed_bridge::RadioBackend radio_backend;
    if (seeed_bridge::flrcRadioInit(&radio_backend)) {
        radio_backend.on_tx_done = onRadioTxDone;
        radio_backend.on_crc_error = onRadioCrcError;
        radio_backend.on_tx_timeout = onRadioTxTimeout;
        radio_backend.on_drop = onRadioDrop;
        core.setRadio(&radio_backend);
        core.noteBootCount(seeed_boot_count() - 1);
    }
#endif

    static uint8_t read_buf[kReadChunk];
    static uint8_t write_buf[kWriteCap];
    int64_t last_stat_ms = k_uptime_get();

    for (;;) {
#if defined(CONFIG_SEEED_BRIDGE_FLRC)
        seeed_bridge::flrcRadioRunEngine();
        seeed_bridge::flrcRadioService();
        char event_text[80];
        while (seeed_bridge::flrcRadioPopEvent(event_text, sizeof(event_text))) {
            size_t event_len =
                core.encodeEvent(event_text, write_buf, sizeof(write_buf));
            if (event_len > 0) {
                queue_host_bytes(write_buf, event_len);
            }
        }
        seeed_bridge::RadioRxPacket packet;
        while (seeed_bridge::flrcRadioPop(&packet)) {
            size_t rx_len = core.encodeRx(packet.rssi_dbm, packet.snr_db,
                                          packet.data, packet.len, write_buf,
                                          sizeof(write_buf));
            if (rx_len > 0) {
                queue_host_bytes(write_buf, rx_len);
            }
        }
#endif

        uint32_t read_len =
            ring_buf_get(&host_rx_ring, read_buf, sizeof(read_buf));

        if (read_len > 0) {
            size_t out_len =
                core.process(read_buf, read_len, write_buf, sizeof(write_buf));
            if (out_len > 0) {
                queue_host_bytes(write_buf, out_len);
            }
        }

        if (k_uptime_get() - last_stat_ms >= kStatPeriodMs) {
            seeed_reset_diag_update_uptime();
            size_t out_len = core.encodeStat(write_buf, sizeof(write_buf));
            if (out_len > 0) {
                queue_host_bytes(write_buf, out_len);
            }
            last_stat_ms = k_uptime_get();
        }

        if (read_len == 0) {
            k_sleep(K_MSEC(1));
        } else {
#if defined(CONFIG_SEEED_BRIDGE_FLRC)
            // Host TX frames were queued during process(); start them now.
            seeed_bridge::flrcRadioService();
            k_yield();
#endif
        }
    }
}
```

## src/bridge_core.cpp
```c
#include "bridge_core.h"

#include <string.h>

namespace seeed_bridge {

BridgeCore::BridgeCore()
    : radio_(NULL), decoder_(), counters_{0}, last_cfg_status_(1) {}

BridgeCore::BridgeCore(const RadioBackend* radio)
    : radio_(radio), decoder_(), counters_{0}, last_cfg_status_(1) {}

bool BridgeCore::append(uint8_t kind, const uint8_t* payload, uint16_t len,
                        uint8_t* out, size_t cap, size_t* used) {
    if (*used > cap) {
        return false;
    }
    size_t written = bridgeEncode(kind, payload, len, out + *used, cap - *used);
    if (written == 0) {
        counters_[Drops]++;
        return false;
    }
    *used += written;
    return true;
}

size_t BridgeCore::encodeStat(uint8_t* out, size_t cap) {
    uint8_t payload[24];
    for (size_t i = 0; i < kCounterCount; i++) {
        payload[i * 4 + 0] = static_cast<uint8_t>(counters_[i] & 0xFF);
        payload[i * 4 + 1] = static_cast<uint8_t>((counters_[i] >> 8) & 0xFF);
        payload[i * 4 + 2] = static_cast<uint8_t>((counters_[i] >> 16) & 0xFF);
        payload[i * 4 + 3] = static_cast<uint8_t>((counters_[i] >> 24) & 0xFF);
    }
    size_t written = bridgeEncode(BR_STAT, payload, sizeof(payload), out, cap);
    if (written == 0) {
        counters_[Drops]++;
    }
    return written;
}

size_t BridgeCore::encodeEvent(const char* text, uint8_t* out, size_t cap) {
    if (text == NULL) {
        return 0;
    }
    size_t len = strlen(text);
    if (len > 200) {
        len = 200;
    }
    size_t written =
        bridgeEncode(BR_EVT, reinterpret_cast<const uint8_t*>(text),
                     static_cast<uint16_t>(len), out, cap);
    if (written == 0) {
        counters_[Drops]++;
    }
    return written;
}

size_t BridgeCore::encodeRx(int16_t rssi_dbm, int8_t snr_db,                            const uint8_t* data, uint16_t len, uint8_t* out,
                            size_t cap) {
    if (len > kMaxRadioPayload || (len > 0 && data == NULL)) {
        counters_[Drops]++;
        return 0;
    }
    uint8_t rx[6 + kMaxRadioPayload];
    rx[0] = static_cast<uint8_t>(rssi_dbm & 0xFF);
    rx[1] = static_cast<uint8_t>((rssi_dbm >> 8) & 0xFF);
    rx[2] = static_cast<uint8_t>(snr_db);
    rx[3] = 1;  // The radio CRC passed before we got an RX_PACKET callback.
    rx[4] = static_cast<uint8_t>(len & 0xFF);
    rx[5] = static_cast<uint8_t>(len >> 8);
    if (len > 0) {
        memcpy(rx + 6, data, len);
    }
    size_t written = bridgeEncode(BR_RX, rx, static_cast<uint16_t>(6 + len), out,
                                  cap);
    if (written == 0) {
        counters_[Drops]++;
        return 0;
    }
    counters_[RxPackets]++;
    return written;
}

void BridgeCore::noteTxDone() { counters_[TxPackets]++; }

void BridgeCore::noteCrcError() { counters_[CrcErrors]++; }

void BridgeCore::noteTxTimeout() { counters_[TxTimeouts]++; }

void BridgeCore::noteDrop() { counters_[Drops]++; }

void BridgeCore::noteBootCount(uint32_t resets) { counters_[Resets] = resets; }

void BridgeCore::handleHello(uint8_t* out, size_t cap, size_t* used) {
    uint16_t chip_id = 0;
    uint16_t capabilities = kCapabilitiesLoopback;
    if (radio_ != NULL) {
        if (radio_->chip_id != NULL) {
            chip_id = radio_->chip_id(radio_->context);
        }
        if (radio_->capabilities != NULL) {
            capabilities = radio_->capabilities(radio_->context);
        }
    }
    const uint8_t ack[8] = {
        1,
        kFirmwareMajor,
        kFirmwareMinor,
        kFirmwarePatch,
        static_cast<uint8_t>(chip_id & 0xFF),
        static_cast<uint8_t>(chip_id >> 8),
        static_cast<uint8_t>(capabilities & 0xFF),
        static_cast<uint8_t>(capabilities >> 8),
    };
    (void)append(BR_HELLO_ACK, ack, sizeof(ack), out, cap, used);
}

void BridgeCore::handleCfg(const BridgeFrame& frame, uint8_t* out, size_t cap,
                           size_t* used) {
    CfgPayload cfg;
    uint8_t status = 3;  // malformed
    if (cfgDecode(frame.payload, frame.len, cfg)) {
        if (radio_ != NULL && radio_->configure != NULL) {
            status = 2;
            if (!radio_->configure(radio_->context, cfg, &status)) {
                if (status == 0) {
                    status = 2;
                }
            } else {
                status = 0;
            }
        } else {
            status = 1;  // radio backend unavailable
        }
    }

    last_cfg_status_ = status;
    uint8_t ack[10];
    cfgAckEncode(status, cfg, ack);
    if (status != 0) {
        counters_[Drops]++;
    }
    (void)append(BR_CFG_ACK, ack, sizeof(ack), out, cap, used);
}

void BridgeCore::handleTx(const BridgeFrame& frame, uint8_t* out, size_t cap,
                          size_t* used) {
    if (frame.len == 0 || frame.len > kMaxRadioPayload) {
        counters_[Drops]++;
        return;
    }

    if (radio_ != NULL) {
        if (radio_->send == NULL ||
            !radio_->send(radio_->context, frame.payload, frame.len)) {
            counters_[Drops]++;
        }
        // TX completion arrives asynchronously through noteTxDone(); RX comes
        // back through encodeRx(). Never echo here: that would be loopback.
        return;
    }

    uint8_t rx[6 + kMaxLoopbackPayload];
    rx[0] = 0;  // RSSI dBm, int16 LE: loopback has no RF measurement.
    rx[1] = 0;
    rx[2] = 0;  // SNR dB.
    rx[3] = 1;  // CRC OK for an in-process loopback.
    rx[4] = static_cast<uint8_t>(frame.len & 0xFF);
    rx[5] = static_cast<uint8_t>(frame.len >> 8);
    memcpy(rx + 6, frame.payload, frame.len);
    if (append(BR_RX, rx, static_cast<uint16_t>(6 + frame.len), out, cap, used)) {
        counters_[TxPackets]++;
        counters_[RxPackets]++;
    }
}

void BridgeCore::handleDiag(uint8_t* out, size_t cap, size_t* used) {
    char text[512];
    size_t len = 0;
    if (radio_ != NULL && radio_->diagnostics != NULL) {
        len = radio_->diagnostics(radio_->context, text, sizeof(text));
    }
    if (len == 0) {
        const char* fallback = "radio=none\n";
        len = strlen(fallback);
        if (len > sizeof(text)) {
            len = sizeof(text);
        }
        memcpy(text, fallback, len);
    }
    (void)append(BR_DIAG_ACK, reinterpret_cast<const uint8_t*>(text),
                 static_cast<uint16_t>(len), out, cap, used);
}

void BridgeCore::handle(const BridgeFrame& frame, uint8_t* out, size_t cap,
                        size_t* used) {
    switch (frame.kind) {
    case BR_HELLO:
        handleHello(out, cap, used);
        break;
    case BR_CFG:
        handleCfg(frame, out, cap, used);
        break;
    case BR_TX:
        handleTx(frame, out, cap, used);
        break;
    case BR_DIAG:
        handleDiag(out, cap, used);
        break;
    case BR_PING: {
        const size_t before = *used;
        if (!append(BR_PONG, NULL, 0, out, cap, used)) {
            break;
        }
        uint8_t stat[64];
        size_t n = encodeStat(stat, sizeof(stat));
        if (n == 0 || *used + n > cap) {
            *used = before;
            counters_[Drops]++;
        } else {
            memcpy(out + *used, stat, n);
            *used += n;
        }
        break;
    }
    default:
        counters_[Drops]++;
        break;
    }
}

size_t BridgeCore::process(const uint8_t* data, size_t len, uint8_t* out,
                           size_t cap) {
    size_t used = 0;
    if (len == 0) {
        return 0;
    }
    if (data == NULL || out == NULL || cap == 0) {
        counters_[Drops]++;
        return 0;
    }
    if (!decoder_.push(data, len)) {
        counters_[Drops]++;
        return 0;
    }

    BridgeFrame frame;
    while (decoder_.next(frame)) {
        handle(frame, out, cap, &used);
    }
    return used;
}

}  // namespace seeed_bridge
```

## src/bridge_core.h
```c
#pragma once

#include <stddef.h>
#include <stdint.h>

#include "bridge_protocol.h"

namespace seeed_bridge {

// Capability bits from docs/BRIDGE-PROTOCOL.md.
static const uint16_t kCapabilitySubGhz = 0x0001;
static const uint16_t kCapability2G4 = 0x0002;
static const uint16_t kCapabilityRelay = 0x0004;
static const uint16_t kCapabilityVariableLength = 0x0008;

// Loopback advertises only what it can do without a radio.
static const uint16_t kCapabilitiesLoopback = kCapabilityVariableLength;
// The FLRC backend implements both front-end paths but this build is only
// verified on 2.4 GHz; the sub-GHz bit is added after that gate passes.
static const uint16_t kCapabilitiesFlrc = kCapability2G4 | kCapabilityVariableLength;

static const uint16_t kMaxLoopbackPayload = 255;
static const uint16_t kMaxRadioPayload = 255;
static const uint8_t kFirmwareMajor = 0;
static const uint8_t kFirmwareMinor = 2;
static const uint8_t kFirmwarePatch = 0;

// Firmware-side radio adapter. The core stays free of Zephyr/USP headers so it
// can be compiled and unit-tested on the host.
struct RadioBackend {
    void* context;
    // Apply one CFG payload. Return true only when the requested profile was
    // actually programmed; status receives the CFG_ACK status byte.
    bool (*configure)(void* context, const CfgPayload& cfg, uint8_t* status);
    // Queue one raw radio packet. Return false when the radio is unavailable
    // or its bounded queue is full.
    bool (*send)(void* context, const uint8_t* data, uint16_t len);
    // LR2021 version as (major << 8) | minor, or zero when not yet read.
    uint16_t (*chip_id)(void* context);
    // Capability bits implemented by this build.
    uint16_t (*capabilities)(void* context);
    // Optional radio event notifications. The core turns each into one STAT
    // counter when the firmware wires these callbacks.
    void (*on_tx_done)(void* context);
    void (*on_crc_error)(void* context);
    void (*on_tx_timeout)(void* context);
    void (*on_drop)(void* context);
    // Optional human-readable diagnostics (boot record, radio/RAC counters).
    // Returns the number of bytes written to `out`, or 0 when unavailable.
    size_t (*diagnostics)(void* context, char* out, size_t cap);
};

// Host-protocol bridge core. With no RadioBackend it reproduces the previous
// loopback behavior; with one it programs the radio and reports RX packets
// supplied by the firmware.
class BridgeCore {
public:
    static const size_t kCounterCount = 6;

    BridgeCore();
    explicit BridgeCore(const RadioBackend* radio);

    void setRadio(const RadioBackend* radio) { radio_ = radio; }
    const RadioBackend* radio() const { return radio_; }

    // Consume arbitrary host bytes and append complete response frames.
    // Returns the number of appended bytes, or zero when no response is ready
    // or the output buffer is too small.
    size_t process(const uint8_t* data, size_t len, uint8_t* out, size_t cap);

    // Encode the current counters as a STAT frame.
    size_t encodeStat(uint8_t* out, size_t cap);

    // Encode a UTF-8 diagnostic event. Not used on the throughput path.
    size_t encodeEvent(const char* text, uint8_t* out, size_t cap);

    // Encode one valid received radio packet as a BR_RX frame and count it.
    size_t encodeRx(int16_t rssi_dbm, int8_t snr_db, const uint8_t* data,
                    uint16_t len, uint8_t* out, size_t cap);

    // Radio event notifications. Each maps directly to one STAT counter.
    void noteTxDone();
    void noteCrcError();
    void noteTxTimeout();
    void noteDrop();
    // Cumulative warm-reset count from the persistent boot record. This is an
    // assignment, not an increment, so STAT reports the same value across reads.
    void noteBootCount(uint32_t resets);

    const uint32_t* counters() const { return counters_; }
    uint8_t lastCfgStatus() const { return last_cfg_status_; }

private:
    enum Counter {
        TxPackets = 0,
        RxPackets = 1,
        CrcErrors = 2,
        Drops = 3,
        TxTimeouts = 4,
        Resets = 5,
    };

    bool append(uint8_t kind, const uint8_t* payload, uint16_t len,
                uint8_t* out, size_t cap, size_t* used);
    void handle(const BridgeFrame& frame, uint8_t* out, size_t cap, size_t* used);
    void handleHello(uint8_t* out, size_t cap, size_t* used);
    void handleCfg(const BridgeFrame& frame, uint8_t* out, size_t cap,
                   size_t* used);
    void handleTx(const BridgeFrame& frame, uint8_t* out, size_t cap,
                  size_t* used);
    void handleDiag(uint8_t* out, size_t cap, size_t* used);

    const RadioBackend* radio_;
    BridgeDecoder decoder_;
    uint32_t counters_[kCounterCount];
    uint8_t last_cfg_status_;
};

// Preserve the original type name used by the existing host tests.
using LoopbackCore = BridgeCore;

}  // namespace seeed_bridge
```

## src/fatal_hook.cpp
```c
/*
 * Capture a Zephyr fatal error in the persistent boot record before rebooting.
 *
 * HW_STACK_PROTECTION is enabled, so a stack overflow raises a fatal error and
 * reaches this handler rather than silently corrupting memory. The modem crash
 * log does not see Zephyr fatals, so the shared noinit record is the only place
 * that survives both paths.
 */

#include <zephyr/arch/cpu.h>
#include <zephyr/fatal.h>
#include <zephyr/kernel.h>
#include <zephyr/sys/reboot.h>

#include "reset_diag.h"

extern "C" void k_sys_fatal_error_handler(unsigned int reason,
                                          const struct arch_esf* esf) {
    uint32_t pc = 0;
    uint32_t lr = 0;
    if (esf != NULL) {
        pc = esf->basic.pc;
        lr = esf->basic.lr;
    }

    k_tid_t thread = k_current_get();
    const char* name = NULL;
#if defined(CONFIG_THREAD_NAME)
    name = k_thread_name_get(thread);
#endif

    seeed_reset_diag_fatal(reason, pc, lr,
                           static_cast<uint32_t>(reinterpret_cast<uintptr_t>(thread)),
                           name);

    sys_reboot(SYS_REBOOT_COLD);
    for (;;) {
        k_sleep(K_FOREVER);
    }
}
```

## src/flrc_radio.h
```c
#pragma once

#include <stdint.h>

#include "bridge_core.h"

namespace seeed_bridge {

struct RadioRxPacket {
    int16_t rssi_dbm;
    int8_t snr_db;
    uint16_t len;
    uint8_t data[kMaxRadioPayload];
};

// Bring up the LR2021 RAC/FLRC backend. Returns false when the radio cannot be
// opened. The bridge stays in loopback when this fails.
bool flrcRadioInit(RadioBackend* backend);

// Service RAC timers and radio IRQs. Call from the main loop.
void flrcRadioRunEngine();

// Start or re-arm RX/TX from main-loop context. Call after flrcRadioRunEngine.
void flrcRadioService();

// Non-blocking pop of one received packet. Call only from the main thread.
bool flrcRadioPop(RadioRxPacket* packet);

// Non-blocking pop of one diagnostic event string.
bool flrcRadioPopEvent(char* text, size_t cap);

// Human-readable diagnostics for the BR_DIAG request. Returns the number of
// bytes written, or 0 when unavailable.
size_t flrcRadioDiagnostics(void* context, char* out, size_t cap);

}  // namespace seeed_bridge
```

## src/reset_diag.cpp
```c
#include "reset_diag.h"

#include <stddef.h>
#include <stdio.h>
#include <string.h>

#include <zephyr/init.h>
#include <zephyr/kernel.h>
#include <zephyr/linker/section_tags.h>

#include <hal/nrf_reset.h>

/*
 * The record deliberately has C linkage so pyocd can locate it by symbol name
 * while the firmware is running or halted. It lives in .noinit, which the C
 * runtime does not clear, so it survives a warm reset.
 */
extern "C" {
__noinit seeed_boot_record_t seeed_boot_record;
}

namespace {

constexpr uint32_t kBootMagic = SEEED_BOOT_MAGIC;
constexpr uint32_t kFatalMagic = SEEED_FATAL_MAGIC;
constexpr uint32_t kRecordVersion = SEEED_BOOT_RECORD_VERSION;

uint32_t fnv1a(const uint8_t* data, size_t len) {
    uint32_t hash = 2166136261u;
    for (size_t i = 0; i < len; i++) {
        hash ^= data[i];
        hash *= 16777619u;
    }
    return hash;
}

uint32_t recordChecksum(const seeed_boot_record_t& record) {
    return fnv1a(reinterpret_cast<const uint8_t*>(&record),
                 offsetof(seeed_boot_record_t, checksum));
}

struct ResetBit {
    uint32_t bit;
    const char* name;
};

constexpr ResetBit kResetBits[] = {
    {1u << 0, "PIN"},        {1u << 1, "DOG0"},       {1u << 2, "DOG1"},
    {1u << 3, "CTRLAPSOFT"}, {1u << 4, "CTRLAPHARD"}, {1u << 5, "CTRLAPPIN"},
    {1u << 6, "SREQ"},       {1u << 7, "LOCKUP"},     {1u << 8, "OFF"},
    {1u << 9, "LPCOMP"},     {1u << 10, "DIF"},
};

void appendText(char* out, size_t cap, size_t* used, const char* text) {
    if (*used >= cap) {
        return;
    }
    size_t room = cap - *used - 1;
    size_t len = strnlen(text, room);
    memcpy(out + *used, text, len);
    *used += len;
    out[*used] = '\0';
}

void appendResetBits(char* out, size_t cap, size_t* used, uint32_t reason) {
    if (reason == 0) {
        appendText(out, cap, used, "none");
        return;
    }
    bool first = true;
    uint32_t remaining = reason;
    for (const ResetBit& entry : kResetBits) {
        if ((reason & entry.bit) == 0) {
            continue;
        }
        if (!first) {
            appendText(out, cap, used, "|");
        }
        appendText(out, cap, used, entry.name);
        first = false;
        remaining &= ~entry.bit;
    }
    if (remaining != 0 || first) {
        char hex[16];
        snprintf(hex, sizeof(hex), first ? "0x%08x" : "|0x%08x",
                 static_cast<unsigned>(remaining));
        appendText(out, cap, used, hex);
    }
}

}  // namespace

extern "C" int seeed_reset_diag_init(void) {
    uint32_t reason = nrf_reset_resetreas_get(NRF_RESET);
    nrf_reset_resetreas_clear(NRF_RESET, reason);

    bool valid = (seeed_boot_record.magic == kBootMagic) &&
                 (seeed_boot_record.version == kRecordVersion) &&
                 (seeed_boot_record.checksum == recordChecksum(seeed_boot_record));

    uint32_t previous_boots = valid ? seeed_boot_record.boot_count : 0;
    uint32_t fatal_magic = valid ? seeed_boot_record.fatal_magic : 0;
    uint32_t fatal_count = valid ? seeed_boot_record.fatal_count : 0;
    uint32_t fatal_reason = valid ? seeed_boot_record.fatal_reason : 0;
    uint32_t fatal_pc = valid ? seeed_boot_record.fatal_pc : 0;
    uint32_t fatal_lr = valid ? seeed_boot_record.fatal_lr : 0;
    uint32_t fatal_thread_id = valid ? seeed_boot_record.fatal_thread_id : 0;
    char fatal_thread[SEEED_THREAD_NAME_MAX] = {0};
    if (valid) {
        memcpy(fatal_thread, seeed_boot_record.fatal_thread,
               sizeof(fatal_thread) - 1);
    }

    memset(&seeed_boot_record, 0, sizeof(seeed_boot_record));
    seeed_boot_record.magic = kBootMagic;
    seeed_boot_record.version = kRecordVersion;
    seeed_boot_record.boot_count = previous_boots + 1;
    seeed_boot_record.resetreas = reason;
    seeed_boot_record.fatal_magic = fatal_magic;
    seeed_boot_record.fatal_count = fatal_count;
    seeed_boot_record.fatal_reason = fatal_reason;
    seeed_boot_record.fatal_pc = fatal_pc;
    seeed_boot_record.fatal_lr = fatal_lr;
    seeed_boot_record.fatal_thread_id = fatal_thread_id;
    memcpy(seeed_boot_record.fatal_thread, fatal_thread,
           sizeof(seeed_boot_record.fatal_thread));
    seeed_boot_record.last_uptime_ms = 0;
    seeed_boot_record.checksum = recordChecksum(seeed_boot_record);
    return 0;
}

SYS_INIT(seeed_reset_diag_init, PRE_KERNEL_1, 0);

extern "C" uint32_t seeed_boot_count(void) {
    return seeed_boot_record.boot_count;
}

extern "C" uint32_t seeed_reset_reason(void) {
    return seeed_boot_record.resetreas;
}

extern "C" int seeed_last_boot_was_reset(void) {
    return seeed_boot_record.boot_count > 1;
}

extern "C" void seeed_reset_diag_update_uptime(void) {
    seeed_boot_record.last_uptime_ms = k_uptime_get_32();
    seeed_boot_record.checksum = recordChecksum(seeed_boot_record);
}

extern "C" void seeed_reset_diag_format(char* out, size_t cap) {
    if (out == NULL || cap == 0) {
        return;
    }
    size_t used = 0;
    char head[48];
    snprintf(head, sizeof(head), "boot#%u rst=",
             static_cast<unsigned>(seeed_boot_record.boot_count));
    appendText(out, cap, &used, head);
    appendResetBits(out, cap, &used, seeed_boot_record.resetreas);
    char tail[48];
    snprintf(tail, sizeof(tail), " up=%ums",
             static_cast<unsigned>(seeed_boot_record.last_uptime_ms));
    appendText(out, cap, &used, tail);
}

extern "C" int seeed_reset_diag_fatal_format(char* out, size_t cap) {
    if (out == NULL || cap == 0) {
        return 0;
    }
    if (seeed_boot_record.fatal_magic != kFatalMagic) {
        out[0] = '\0';
        return 0;
    }
    snprintf(out, cap, "fatal#%u r=%u pc=%08x lr=%08x th=%s",
             static_cast<unsigned>(seeed_boot_record.fatal_count),
             static_cast<unsigned>(seeed_boot_record.fatal_reason),
             static_cast<unsigned>(seeed_boot_record.fatal_pc),
             static_cast<unsigned>(seeed_boot_record.fatal_lr),
             seeed_boot_record.fatal_thread[0] != '\0'
                 ? seeed_boot_record.fatal_thread
                 : "?");
    return 1;
}

extern "C" void seeed_reset_diag_fatal(unsigned int reason, uint32_t pc,
                                        uint32_t lr, uint32_t thread_id,
                                        const char* thread_name) {
    seeed_boot_record.fatal_magic = kFatalMagic;
    seeed_boot_record.fatal_count++;
    seeed_boot_record.fatal_reason = reason;
    seeed_boot_record.fatal_pc = pc;
    seeed_boot_record.fatal_lr = lr;
    seeed_boot_record.fatal_thread_id = thread_id;
    memset(seeed_boot_record.fatal_thread, 0,
           sizeof(seeed_boot_record.fatal_thread));
    if (thread_name != NULL) {
        strncpy(seeed_boot_record.fatal_thread, thread_name,
                sizeof(seeed_boot_record.fatal_thread) - 1);
    }
    seeed_boot_record.last_uptime_ms = k_uptime_get_32();
    seeed_boot_record.checksum = recordChecksum(seeed_boot_record);
}
```

## src/reset_diag.h
```c
#pragma once

#include <stddef.h>
#include <stdint.h>

#ifdef __cplusplus
extern "C" {
#endif

#define SEEED_BOOT_MAGIC 0x53454544u   /* 'SEED' */
#define SEEED_FATAL_MAGIC 0x4641544cu  /* 'FATL' */
#define SEEED_BOOT_RECORD_VERSION 1u
#define SEEED_THREAD_NAME_MAX 16

/*
 * Survives a warm reset in .noinit. A power cycle loses it, which is why the
 * magic is validated and a lost record is reported rather than trusted.
 *
 * resetreas is the raw nRF RESETREAS value captured at the very start of this
 * boot, before any driver can clear it. The decoded names are produced by
 * seeed_reset_diag_format().
 */
typedef struct {
    uint32_t magic;
    uint32_t version;
    uint32_t boot_count;
    uint32_t resetreas;       /* reason for THIS boot */
    uint32_t fatal_magic;
    uint32_t fatal_count;
    uint32_t fatal_reason;
    uint32_t fatal_pc;
    uint32_t fatal_lr;
    uint32_t fatal_thread_id;
    char fatal_thread[SEEED_THREAD_NAME_MAX];
    uint32_t last_uptime_ms;
    uint32_t checksum;
} seeed_boot_record_t;

extern seeed_boot_record_t seeed_boot_record;

/* Runs at PRE_KERNEL_1, before the reset cause can be consumed elsewhere. */
int seeed_reset_diag_init(void);

uint32_t seeed_boot_count(void);
uint32_t seeed_reset_reason(void);
int seeed_last_boot_was_reset(void);

/* Refresh the recorded uptime/checksum so a later crash shows how far it got. */
void seeed_reset_diag_update_uptime(void);

/* "boot#3 rst=SREQ up=12345ms" — always NUL-terminated. */
void seeed_reset_diag_format(char* out, size_t cap);

/* "fatal r=3 pc=0000abcd lr=0000ef01 th=main" when one was recorded. */
int seeed_reset_diag_fatal_format(char* out, size_t cap);

/* Called from the fatal handler immediately before the reboot. */
void seeed_reset_diag_fatal(unsigned int reason, uint32_t pc, uint32_t lr,
                            uint32_t thread_id, const char* thread_name);

#ifdef __cplusplus
}
#endif
```
